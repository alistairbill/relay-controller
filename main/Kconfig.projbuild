## main/Kconfig.projbuild
```kconfig
menu "Relay Controller"
config GPIO_PUMP
    int "Pump relay GPIO pin"
    default 5
    help
        GPIO pin for pump relay

config GPIO_LIGHT
    int "Light relay GPIO pin"
    default 4
    help
        GPIO pin for light relay

config WIFI_SSID
    string "WiFi SSID"
    default "myssid"
    help
        SSID (network name) to connect to.

config WIFI_PASSWORD
    string "WiFi Password"
    default "mypassword"
    help
        WiFi password (WPA or WPA2).

config MQTT_URI
    string "MQTT Broker URI"
    default "mqtt://test.example.org:1883"
    help
        URI to the MQTT broker.

config MQTT_USERNAME
    string "MQTT Username"
    default ""
    help
        Username for connecting to the MQTT broker.

config MQTT_PASSWORD
    string "MQTT Password"
    default ""
    help
        Password for connecting to the MQTT broker.

config ENABLE_OTA
    bool "Enable OTA"
    default y
    help
        Enable over-the-air firmware updates.

config OTA_URL
    depends on ENABLE_OTA
    string "OTA firmware URL"
    default "http://example.org/build/example.bin"
    help
        URL to the firmware.
endmenu
```
